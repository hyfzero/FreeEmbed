# file: test_led.ioc
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Mcu.Family=STM32F1
Mcu.Name=STM32F103Z(C-D-E)Tx
Mcu.Package=LQFP144
NVIC.PriorityGroup=NVIC_PRIORITYGROUP_4
NVIC.TIM1_UP_IRQn=true\:15\:0\:false\:false\:true\:false\:true\:true
NVIC.TimeBase=TIM1_UP_IRQn
NVIC.TimeBaseIP=TIM1
OSC_IN.Mode=HSE-External-Oscillator
OSC_IN.Signal=RCC_OSC_IN
OSC_OUT.Mode=HSE-External-Oscillator
OSC_OUT.Signal=RCC_OSC_OUT
PA13.Mode=Serial_Wire
PA13.Signal=SYS_JTMS-SWDIO
PA14.Mode=Serial_Wire
PA14.Signal=SYS_JTCK-SWCLK
PB5.Signal=GPIO_Output
ProjectManager.HeapSize=0x200
ProjectManager.StackSize=0x400
ProjectManager.TargetToolchain=MDK-ARM V5.32
RCC.AHBFreq_Value=72000000
RCC.APB1CLKDivider=RCC_HCLK_DIV2
RCC.APB1Freq_Value=36000000
RCC.APB1TimFreq_Value=72000000
RCC.APB2Freq_Value=72000000
RCC.APB2TimFreq_Value=72000000
RCC.HCLKFreq_Value=72000000
RCC.PLLMUL=RCC_PLL_MUL9
RCC.PLLSourceVirtual=RCC_PLLSOURCE_HSE
RCC.SYSCLKFreq_VALUE=72000000
RCC.SYSCLKSource=RCC_SYSCLKSOURCE_PLLCLK
RCC.USBFreq_Value=72000000
VP_SYS_VS_tim1.Mode=TIM1
board=custom

// file: Core/Src/main.c
/* USER CODE BEGIN Header */
/**
  ******************************************************************************
  * @file           : main.c
  * @brief          : Main program body
  ******************************************************************************
  * @attention
  *
  * Copyright (c) 2026 STMicroelectronics.
  * All rights reserved.
  *
  * This software is licensed under terms that can be found in the LICENSE file
  * in the root directory of this software component.
  * If no LICENSE file comes with this software, it is provided AS-IS.
  *
  ******************************************************************************
  */
/* USER CODE END Header */
#include "main.h"

/* USER CODE BEGIN Includes */
#include "board.h"

#include <stdint.h>
#include <string.h>

/* USER CODE END Includes */

/* USER CODE BEGIN PD */
#define FLASH_TEST_ADDRESS     0x000000UL
#define FLASH_TEST_ERASE_SIZE  4096UL

/* USER CODE END PD */

/* USER CODE BEGIN PV */
static const uint8_t flash_test_pattern[] =
    "W25Q64 SPI NOR self test from Example/test_spi";
static uint8_t flash_test_readback[ sizeof( flash_test_pattern ) ];

volatile StorageStatus g_flash_init_status = STORAGE_NOT_INITIALIZED;
volatile StorageStatus g_flash_info_status = STORAGE_NOT_INITIALIZED;
volatile StorageStatus g_flash_erase_status = STORAGE_NOT_INITIALIZED;
volatile StorageStatus g_flash_program_status = STORAGE_NOT_INITIALIZED;
volatile StorageStatus g_flash_read_status = STORAGE_NOT_INITIALIZED;
volatile uint32_t g_flash_compare_ok = 0U;
volatile uint64_t g_flash_capacity_bytes = 0U;
volatile uint32_t g_flash_page_size_bytes = 0U;
volatile uint32_t g_flash_erase_size_bytes = 0U;

/* USER CODE END PV */

void SystemClock_Config(void);
static void MX_GPIO_Init(void);

#include<stdint.h>
#include<stdio.h>
#include<stdlib.h>

// #define alignment_byte               0x07
// #define configSysTickClockHz			( ( unsigned long ) 72000000 )
// #define configTickRateHz			( ( uint32_t ) 1000 )
// #define configShieldInterPriority 	191
// #define config_heap   8*1024
// #define configMaxPriority  32

// #define Class(class)    \
// typedef struct  class  class;\
// struct class

// #define MIN_size     ((size_t) (HeapStructSize << 1))

// Class(heap_node){
//     heap_node *next;
//     size_t BlockSize;
// };

// Class(xheap){
//     heap_node head;
//     heap_node *tail;
//     size_t AllSize;
// };

// xheap TheHeap = {
//         .tail = NULL,
//         .AllSize = config_heap,
// };

// static  uint8_t AllHeap[config_heap];
// static const size_t HeapStructSize = (sizeof(heap_node) + (size_t)(alignment_byte)) &~(alignment_byte);

// void heap_init( void )
// {
//     heap_node *first_node;
//     uint32_t start_heap ,end_heap;
//     //get start address
//     start_heap =(uint32_t) AllHeap;
//     if( (start_heap & alignment_byte) != 0){
//         start_heap += alignment_byte ;
//         start_heap &= ~alignment_byte;
//         TheHeap.AllSize -=  (size_t)(start_heap - (uint32_t)AllHeap);//byte alignment means move to high address,so sub it!
//     }
//     TheHeap.head.next = (heap_node *)start_heap;
//     TheHeap.head.BlockSize = (size_t)0;
//     end_heap = start_heap + (uint32_t)TheHeap.AllSize - (uint32_t)HeapStructSize;
//     if( (end_heap & alignment_byte) != 0){
//         end_heap &= ~alignment_byte;
//         TheHeap.AllSize =  (size_t)(end_heap - start_heap );
//     }
//     TheHeap.tail = (heap_node *)end_heap;
//     TheHeap.tail->BlockSize  = 0;
//     TheHeap.tail->next =NULL;
//     first_node = (heap_node *)start_heap;
//     first_node->next = TheHeap.tail;
//     first_node->BlockSize = TheHeap.AllSize;
// }

// void *heap_malloc(size_t WantSize)
// {
//     heap_node *prev_node;
//     heap_node *use_node;
//     heap_node *new_node;
//     size_t alignment_require_size;
//     void *xReturn = NULL;
//     WantSize += HeapStructSize;
//     if((WantSize & alignment_byte) != 0x00) {
//         alignment_require_size = (alignment_byte + 1) - (WantSize & alignment_byte);//must 8-byte alignment
//         WantSize += alignment_require_size;
//     }//You can add the TaskSuspend function ,that make here be an atomic operation
//     if(TheHeap.tail== NULL ) {
//         heap_init();
//     }//Resume
//     prev_node = &TheHeap.head;
//     use_node = TheHeap.head.next;
//     while((use_node->BlockSize) < WantSize) {//check the size is fit
//         prev_node = use_node;
//         use_node = use_node->next;
//         if(use_node == NULL){
//             return xReturn;
//         }
//     }
//     xReturn = (void*)( ( (uint8_t*)use_node ) + HeapStructSize );
//     prev_node->next = use_node->next ;
//     if( (use_node->BlockSize - WantSize) > MIN_size ) {
//         new_node = (void *) (((uint8_t *) use_node) + WantSize);
//         new_node->BlockSize = use_node->BlockSize - WantSize;
//         use_node->BlockSize = WantSize;
//         new_node->next = prev_node->next;
//         prev_node->next = new_node;
//     }//Finish cutting
//     TheHeap.AllSize-= use_node->BlockSize;
//     use_node->next = NULL;
//     return xReturn;
// }

// static void InsertFreeBlock(heap_node* xInsertBlock);
// void heap_free(void *xReturn)
// {
//     heap_node *xlink;
//     uint8_t *xFree = (uint8_t*)xReturn;

//     xFree -= HeapStructSize;//get the start address of the heap struct
//     xlink = (void*)xFree;
//     TheHeap.AllSize += xlink->BlockSize;
//     InsertFreeBlock((heap_node*)xlink);
// }

// static void InsertFreeBlock(heap_node* xInsertBlock)
// {
//     heap_node *first_fit_node;
//     uint8_t* getaddr;

//     for(first_fit_node = &TheHeap.head;first_fit_node->next < xInsertBlock;first_fit_node = first_fit_node->next)
//     { /*finding the fit node*/ }

//     xInsertBlock->next = first_fit_node->next;
//     first_fit_node->next = xInsertBlock;

//     getaddr = (uint8_t*)xInsertBlock;
//     if((getaddr + xInsertBlock->BlockSize) == (uint8_t*)(xInsertBlock->next)) {
//         if (xInsertBlock->next != TheHeap.tail) {
//             xInsertBlock->BlockSize += xInsertBlock->next->BlockSize;
//             xInsertBlock->next = xInsertBlock->next->next;
//         } else {
//             xInsertBlock->next = TheHeap.tail;
//         }
//     }
//     getaddr = (uint8_t*)first_fit_node;
//     if((getaddr + first_fit_node->BlockSize) == (uint8_t*) xInsertBlock) {
//         first_fit_node->BlockSize += xInsertBlock->BlockSize;
//         first_fit_node->next = xInsertBlock->next;
//     }
// }

// Class(Stack_register)
// {
//     //manual stacking
//     uint32_t r4;
//     uint32_t r5;
//     uint32_t r6;
//     uint32_t r7;
//     uint32_t r8;
//     uint32_t r9;
//     uint32_t r10;
//     uint32_t r11;
//     //automatic stacking
//     uint32_t r0;
//     uint32_t r1;
//     uint32_t r2;
//     uint32_t r3;
//     uint32_t r12;
//     uint32_t LR;
//     uint32_t PC;
//     uint32_t xPSR;
// };

// Class(TCB_t)
// {
//     volatile uint32_t * pxTopOfStack;
//     unsigned long uxPriority;
//     uint32_t * pxStack;
//     Stack_register *self_stack;//Save the status of the stack in the task !You can use gdb to debug it!
// };
// typedef  TCB_t         *TaskHandle_t;

// __attribute__( ( used ) )  TCB_t * volatile pxCurrentTCB = NULL;
// typedef void (* TaskFunction_t)( void * );

// #define vPortSVCHandler SVC_Handler
// #define xPortPendSVHandler PendSV_Handler

// __asm void vPortSVCHandler( void )
// {
// 	  PRESERVE8

// 	  ldr	r3, =pxCurrentTCB	/* Restore the context. */
// 	  ldr r1, [r3]			/* Use pxCurrentTCBConst to get the pxCurrentTCB address. */
// 	  ldr r0, [r1]			/* The first item in pxCurrentTCB is the task top of stack. */
// 	  ldmia r0!, {r4-r11}		/* Pop the registers that are not automatically saved on exception entry and the critical nesting count. */
// 	  msr psp, r0				/* Restore the task stack pointer. */
// 	  isb
// 	  mov r0, #0
// 	  msr	basepri, r0
// 	  orr r14, #0xd
// 	  bx r14
// }

// __asm void xPortPendSVHandler( void )
// {
// 	  extern pxCurrentTCB;
// 	  extern vTaskSwitchContext;

// 	  PRESERVE8

// 	  mrs r0, psp
// 	  isb

// 	  ldr	r3, =pxCurrentTCB		/* Get the location of the current TCB. */
// 	  ldr	r2, [r3]

// 	  stmdb r0!, {r4-r11}			/* Save the remaining registers. */
// 	  str r0, [r2]				/* Save the new top of stack into the first member of the TCB. */

// 	  stmdb sp!, {r3, r14}
// 	  mov r0, configShieldInterPriority
// 	  msr basepri, r0
// 	  dsb
// 	  isb
// 	  bl vTaskSwitchContext
// 	  mov r0, #0
// 	  msr basepri, r0
// 	  ldmia sp!, {r3, r14}

//   	ldr r1, [r3]
// 	  ldr r0, [r1]				/* The first item in pxCurrentTCB is the task top of stack. */
// 	  ldmia r0!, {r4-r11}			/* Pop the registers and the critical nesting count. */
// 	  msr psp, r0
// 	  isb
// 	  bx r14
// 	  nop
// }

// #define switchTask()\
// *( ( volatile uint32_t * ) 0xe000ed04 ) = 1UL << 28UL;

// uint32_t  NextTicks = ~(uint32_t)0;
// uint32_t  TicksBase = 0;

// uint32_t ReadyBitTable = 0;
// TaskHandle_t TcbTaskTable[configMaxPriority];

// uint32_t DelayBitTable = 0;
// uint32_t TicksTable[configMaxPriority];
// uint32_t TicksTableAssist[configMaxPriority];
// uint32_t* WakeTicksTable;
// uint32_t* OverWakeTicksTable;
// #define TicksTableInit( ) {  \
//     WakeTicksTable = TicksTable;    \
//     OverWakeTicksTable = TicksTableAssist;  \
// }
// #define TicksTableSwitch( ){    \
//     uint32_t *temp;             \
//     temp = WakeTicksTable;      \
//     WakeTicksTable = OverWakeTicksTable; \
//     OverWakeTicksTable = temp;  \
//     }

// uint32_t SuspendBitTable = 0;

// //the table is defined for signal mechanism
// uint32_t BlockedBitTable = 0;

// /*The RTOS delay will switch the task.It is used to liberate low-priority task*/
// void TaskDelay( uint16_t ticks )
// {
//     uint32_t WakeTime = TicksBase + ticks;
//     TCB_t *self = pxCurrentTCB;
//     if( WakeTime < TicksBase)
//     {
//         OverWakeTicksTable[self->uxPriority] = WakeTime;
//     }
//     else
//     {
//         WakeTicksTable[self->uxPriority] = WakeTime;
//     }
//     /* This is a useless operation(for DelayBitTable), it can be discarded.
//      * But it is retained for the sake of normativity.For example, view the status of all current tasks.*/
//     DelayBitTable |= (1 << (self->uxPriority) );
//     ReadyBitTable &= ~(1 << (self->uxPriority) );
//     switchTask();
// }

// void CheckTicks( void )
// {
//     TicksBase += 1;
//     if( TicksBase == 0){
//         TicksTableSwitch( );
//     }
//     for(int i=0 ; i < configMaxPriority;i++) {
//         if(  WakeTicksTable[i]  > 0) {
//             if ( TicksBase >= WakeTicksTable[i] ) {
//                 WakeTicksTable[i] = 0;
//                 DelayBitTable &= ~(1 << i );//it is retained for the sake of normativity.
//                 ReadyBitTable |= (1 << i);
//             }
//         }
//     }
//     switchTask();
// }

// __attribute__((always_inline)) uint32_t xEnterCritical( void )
// {
//     uint32_t xReturn;
// 	uint32_t BarrierPriority = configShieldInterPriority;

//     __asm volatile(
//             " cpsid i               \n"
//             " mrs xReturn, basepri       \n"
//             " msr basepri, BarrierPriority       \n"
//             " dsb                   \n"
//             " isb                   \n"
//             " cpsie i               \n"
//             );

//     return xReturn;
// }

// __attribute__((always_inline)) void xExitCritical( uint32_t xReturn )
// {
//     __asm volatile(
//             " cpsid i               \n"
//             " msr basepri, xReturn       \n"
//             " dsb                   \n"
//             " isb                   \n"
//             " cpsie i               \n"
//             );
// }

// void SysTick_Handler(void)
// {
//     uint32_t xre = xEnterCritical();
//     CheckTicks();
//     xExitCritical(xre);
// }

// uint32_t * pxPortInitialiseStack( uint32_t * pxTopOfStack,
//                                   TaskFunction_t pxCode,
//                                   void * pvParameters ,
//                                   TaskHandle_t * const self)
// {
//     pxTopOfStack -= 16;
//     Stack_register *Stack = (Stack_register *)pxTopOfStack;

//     Stack->xPSR = 0x01000000UL;
//     Stack->PC = ( ( uint32_t ) pxCode ) & ( ( uint32_t ) 0xfffffffeUL );
//     Stack->LR = ( uint32_t ) pvParameters;
//     Stack->r0 = ( uint32_t ) self;
//     (*self)->self_stack = Stack;

//     return pxTopOfStack;
// }

// void xTaskCreate( TaskFunction_t pxTaskCode,
//                   const uint16_t usStackDepth,
//                   void * const pvParameters,//it can be used to debug
//                   uint32_t uxPriority,
//                   TaskHandle_t * const self )
// {
//     uint32_t *topStack =NULL;
//     TCB_t *NewTcb = (TCB_t *)heap_malloc(sizeof(TCB_t));
//     *self = ( TCB_t *) NewTcb;
//     TcbTaskTable[uxPriority] = NewTcb;
//     NewTcb->uxPriority = uxPriority;
//     NewTcb->pxStack = ( uint32_t *) heap_malloc( ( ( ( size_t ) usStackDepth ) * sizeof( uint32_t * ) ) );
//     topStack =  NewTcb->pxStack + (usStackDepth - (uint32_t)1) ;
//     topStack = ( uint32_t *) (((uint32_t)topStack) & (~((uint32_t) alignment_byte)));
//     NewTcb->pxTopOfStack = pxPortInitialiseStack(topStack,pxTaskCode,pvParameters,self);

//     pxCurrentTCB = NewTcb;
//     ReadyBitTable |= (1 << uxPriority);
// }

// __attribute__((always_inline)) static inline uint8_t FindHighestPriority(void) {
//     uint8_t TopZeroNumber;
//     uint8_t temp;
//     __asm {
//         clz TopZeroNumber, ReadyBitTable
//         mov temp, #31
//         sub TopZeroNumber, temp, TopZeroNumber
//     }
//     return TopZeroNumber;
// }

// void vTaskSwitchContext( void )
// {
//     pxCurrentTCB = TcbTaskTable[ FindHighestPriority()];
// }

// void EnterSleepMode(void)
// {
//     SCB->SCR &= ~SCB_SCR_SLEEPDEEP_Msk;
//     __WFI();
// }

// //Task handle can be hide, but in order to debug, it must be created manually by the user
// TaskHandle_t leisureTcb = NULL;

// void leisureTask( )
// {//leisureTask content can be manually modified as needed
//     while (1) {
//         EnterSleepMode();
//     }
// }

// void SchedulerInit( void )
// {
//     TicksTableInit();
//     xTaskCreate(    leisureTask,
//                     128,
//                     NULL,
//                     0,
//                     &leisureTcb
//     );
// }

// __asm void prvStartFirstTask( void )
// {
// 	  PRESERVE8
// 	/* Use the NVIC offset register to locate the stack. */
// 	  ldr r0, =0xE000ED08
// 	  ldr r0, [r0]
//   	ldr r0, [r0]
// 	/* Set the msp back to the start of the stack. */
//   	msr msp, r0
// 	/* Globally enable interrupts. */
// 	  cpsie i
// 	  cpsie f
// 	  dsb
// 	  isb
// 	/* Call SVC to start the first task. */
// 	  svc 0
// 	  nop
// 	  nop
// }

// __attribute__( ( always_inline ) ) inline void SchedulerStart( void )
// {
//     /* Start the timer that generates the tick ISR.  Interrupts are disabled
//      * here already. */
//     ( *( ( volatile uint32_t * ) 0xe000ed20 ) ) |= ( ( ( uint32_t ) 255UL ) << 16UL );
//     ( *( ( volatile uint32_t * ) 0xe000ed20 ) ) |= ( ( ( uint32_t ) 255UL ) << 24UL );

//     /* Stop and clear the SysTick. */
//     SysTick->CTRL = 0UL;
//     SysTick->VAL = 0UL;
//     /* Configure SysTick to interrupt at the requested rate. */
//     SysTick->LOAD = ( configSysTickClockHz / configTickRateHz ) - 1UL;
//     SysTick->CTRL = ( ( 1UL << 2UL ) | ( 1UL << 1UL ) | ( 1UL << 0UL ) );

//     /* Start the first task. */
//     prvStartFirstTask();
// }
// TaskHandle_t Task1Handle = NULL;
// void Task1( )
// {
//     while(1) {
//         HAL_GPIO_TogglePin(GPIOB, GPIO_PIN_5);
//         HAL_Delay(500);
//     }
// }
// void app_main(void)
// {
//   xTaskCreate(    Task1,
//                   128,
//                   NULL,
//                   1,
//                   &Task1Handle
//     );
//     //Task Area!The user must create task handle manually because of debugging and specification
// }

/* USER CODE BEGIN PFP */
static int run_flash_self_test( void );

/* USER CODE END PFP */

/* USER CODE BEGIN 0 */
static int run_flash_self_test( void )
{
  StorageInfo info;

  g_flash_init_status = STORAGE_NOT_INITIALIZED;
  g_flash_info_status = STORAGE_NOT_INITIALIZED;
  g_flash_erase_status = STORAGE_NOT_INITIALIZED;
  g_flash_program_status = STORAGE_NOT_INITIALIZED;
  g_flash_read_status = STORAGE_NOT_INITIALIZED;
  g_flash_compare_ok = 0U;
  g_flash_capacity_bytes = 0U;
  g_flash_page_size_bytes = 0U;
  g_flash_erase_size_bytes = 0U;

  memset( flash_test_readback, 0, sizeof( flash_test_readback ) );

  g_flash_init_status = board_flash_init();
  if( g_flash_init_status != STORAGE_OK )
  {
    return 0;
  }

  g_flash_info_status = storage_get_info( g_board_flash, &info );
  if( g_flash_info_status != STORAGE_OK )
  {
    return 0;
  }

  g_flash_capacity_bytes = info.capacity_bytes;
  g_flash_page_size_bytes = info.page_size_bytes;
  g_flash_erase_size_bytes = info.erase_size_bytes;

  g_flash_erase_status = storage_erase( g_board_flash,
                                        FLASH_TEST_ADDRESS,
                                        FLASH_TEST_ERASE_SIZE );
  if( g_flash_erase_status != STORAGE_OK )
  {
    return 0;
  }

  g_flash_program_status = storage_program( g_board_flash,
                                            FLASH_TEST_ADDRESS,
                                            flash_test_pattern,
                                            sizeof( flash_test_pattern ) );
  if( g_flash_program_status != STORAGE_OK )
  {
    return 0;
  }

  g_flash_read_status = storage_read( g_board_flash,
                                      FLASH_TEST_ADDRESS,
                                      flash_test_readback,
                                      sizeof( flash_test_readback ) );
  if( g_flash_read_status != STORAGE_OK )
  {
    return 0;
  }

  g_flash_compare_ok =
      ( memcmp( flash_test_pattern,
                flash_test_readback,
                sizeof( flash_test_pattern ) ) == 0 ) ? 1U : 0U;

  return ( g_flash_compare_ok != 0U ) ? 1 : 0;
}

/* USER CODE END 0 */

int main(void)
{

  /* USER CODE BEGIN 1 */
  int flash_test_ok;

  /* USER CODE END 1 */

  /* MCU Configuration--------------------------------------------------------*/

  /* Reset of all peripherals, Initializes the Flash interface and the Systick. */
  HAL_Init();

  /* Configure the system clock */
  SystemClock_Config();

  /* Initialize all configured peripherals */
  MX_GPIO_Init();
  /* USER CODE BEGIN 2 */
  board_init();
  flash_test_ok = run_flash_self_test();

  /* USER CODE END 2 */
//  SchedulerInit();
//  app_main();
//  SchedulerStart();
  /* Infinite loop */
  while (1)
  {
    /* USER CODE BEGIN 3 */
    if( flash_test_ok != 0 )
    {
      led_on( g_board_led );
      HAL_Delay( 1000 );
    }
    else
    {
      led_on( g_board_led );
      HAL_Delay( 100 );
      led_off( g_board_led );
      HAL_Delay( 100 );
    }
  }
  /* USER CODE END 3 */
}

void SystemClock_Config(void)
{
  RCC_OscInitTypeDef RCC_OscInitStruct = {0};
  RCC_ClkInitTypeDef RCC_ClkInitStruct = {0};

  /** Initializes the RCC Oscillators according to the specified parameters
  * in the RCC_OscInitTypeDef structure.
  */
  RCC_OscInitStruct.OscillatorType = RCC_OSCILLATORTYPE_HSE;
  RCC_OscInitStruct.HSEState = RCC_HSE_ON;
  RCC_OscInitStruct.HSEPredivValue = RCC_HSE_PREDIV_DIV1;
  RCC_OscInitStruct.HSIState = RCC_HSI_ON;
  RCC_OscInitStruct.PLL.PLLState = RCC_PLL_ON;
  RCC_OscInitStruct.PLL.PLLSource = RCC_PLLSOURCE_HSE;
  RCC_OscInitStruct.PLL.PLLMUL = RCC_PLL_MUL9;
  if (HAL_RCC_OscConfig(&RCC_OscInitStruct) != HAL_OK)
  {
    Error_Handler();
  }

  /** Initializes the CPU, AHB and APB buses clocks
  */
  RCC_ClkInitStruct.ClockType = RCC_CLOCKTYPE_HCLK|RCC_CLOCKTYPE_SYSCLK
                              |RCC_CLOCKTYPE_PCLK1|RCC_CLOCKTYPE_PCLK2;
  RCC_ClkInitStruct.SYSCLKSource = RCC_SYSCLKSOURCE_PLLCLK;
  RCC_ClkInitStruct.AHBCLKDivider = RCC_SYSCLK_DIV1;
  RCC_ClkInitStruct.APB1CLKDivider = RCC_HCLK_DIV2;
  RCC_ClkInitStruct.APB2CLKDivider = RCC_HCLK_DIV1;

  if (HAL_RCC_ClockConfig(&RCC_ClkInitStruct, FLASH_LATENCY_2) != HAL_OK)
  {
    Error_Handler();
  }
}

static void MX_GPIO_Init(void)
{
  GPIO_InitTypeDef GPIO_InitStruct = {0};

  /* GPIO Ports Clock Enable */
  __HAL_RCC_GPIOA_CLK_ENABLE();
  __HAL_RCC_GPIOB_CLK_ENABLE();

  /*Configure GPIO pin Output Level */
  HAL_GPIO_WritePin(GPIOB, GPIO_PIN_5, GPIO_PIN_RESET);

  /*Configure GPIO pin : PB5 */
  GPIO_InitStruct.Pin = GPIO_PIN_5;
  GPIO_InitStruct.Mode = GPIO_MODE_OUTPUT_PP;
  GPIO_InitStruct.Pull = GPIO_NOPULL;
  GPIO_InitStruct.Speed = GPIO_SPEED_FREQ_LOW;
  HAL_GPIO_Init(GPIOB, &GPIO_InitStruct);

}

void HAL_TIM_PeriodElapsedCallback(TIM_HandleTypeDef *htim)
{
  if (htim->Instance == TIM1)
  {
    HAL_IncTick();
  }
}

void Error_Handler(void)
{
  __disable_irq();
  while (1)
  {
  }
}
